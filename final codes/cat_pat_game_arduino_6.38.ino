#include <GxEPD2_BW.h>

GxEPD2_BW<GxEPD2_154_D67, GxEPD2_154_D67::HEIGHT> display2(
  GxEPD2_154_D67(/*CS=*/6, /*DC=*/9, /*RST=*/8, /*BUSY=*/5)
);

// ── pupilContract: light detected → slit pupil ──
const unsigned char epd_bitmap_pupilContract[] PROGMEM = {
  0xff, 0xff, 0xff, 0xff, 0xff, 0xff, 0xff, 0xff, 0xff, 0xff, 0xff, 0xff, 0xff, 0xff, 0xff, 0xff, 
	0xff, 0xff, 0xff, 0xff, 0xff, 0xff, 0xff, 0xff, 0xff, 0xff, 0xff, 0xff, 0xff, 0xff, 0xff, 0xff, 
	0xff, 0xff, 0xff, 0xff, 0xff, 0xff, 0xff, 0xff, 0xff, 0xff, 0xff, 0xff, 0xff, 0xff, 0xff, 0xff, 
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	0xff, 0xff, 0xff, 0xff, 0xff, 0xff, 0xff, 0xc0
};

// ── pupilExpand: dark (default) → wide open pupil ──
const unsigned char epd_bitmap_pupilExpand[] PROGMEM = {
  0xff, 0xff, 0xff, 0xff, 0xff, 0xff, 0xff, 0xff, 0xff, 0xff, 0xff, 0xff, 0xff, 0xff, 0xff, 0xff, 
  0xff, 0xff, 0xff, 0xff, 0xff, 0xff, 0xff, 0xff, 0xff, 0xff, 0xff, 0xff, 0xff, 0xff, 0xff, 0xff, 
  0xff, 0xff, 0xff, 0xff, 0xff, 0xff, 0xff, 0xff, 0xff, 0xff, 0xff, 0xff, 0xff, 0xff, 0xff, 0xff, 
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  0xff, 0xff, 0xff, 0xff, 0xff, 0xff, 0xff, 0xc0
};

// ── CONFIG ──
const int LDR_PIN    = A0;
const int LDR_BRIGHT = 500;
const unsigned long MIN_REFRESH_GAP = 4000;
const unsigned long CHECK_INTERVAL  = 500;

// ── STATE ──
int           currentImage = -1;
unsigned long lastRefresh  = 0;
unsigned long lastCheck    = 0;

// ── DRAW — identical structure to working foundation ──
void updateDisplay(const unsigned char* img) {
  Serial.println("Drawing...");

  display2.setFullWindow();
  display2.firstPage();

  do {
    display2.fillScreen(GxEPD_WHITE);
    display2.drawBitmap(0, 0, img, 200, 200, GxEPD_BLACK);
  } while (display2.nextPage());

  display2.hibernate();
  Serial.println("Done.");
}

int averageAnalog(int pin) {
  long sum = 0;
  for (int i = 0; i < 16; i++) {
    sum += analogRead(pin);
    delay(2);
  }
  return sum / 16;
}

void setup() {
  Serial.begin(115200);
  Serial.println("1. Serial OK");

  pinMode(6, OUTPUT); digitalWrite(6, HIGH);
  Serial.println("2. CS pin set");

  display2.init(115200);
  Serial.println("3. Init done");

  display2.setRotation(1);

  Serial.println("4. Drawing...");
  updateDisplay(epd_bitmap_pupilExpand);
  currentImage = 2;
  lastRefresh  = millis();
  Serial.println("5. Done");
}

void loop() {
  unsigned long now = millis();

  if (now - lastCheck >= CHECK_INTERVAL) {
    lastCheck = now;

    int ldr = averageAnalog(LDR_PIN);
    Serial.print("LDR:");
    Serial.println(ldr);

    int wantImage = (ldr <= LDR_BRIGHT) ? 1 : 2;

    if (wantImage != currentImage && (now - lastRefresh >= MIN_REFRESH_GAP)) {
      currentImage = wantImage;
      lastRefresh  = now;

      if (wantImage == 1) {
        Serial.println("Light → contract");
        updateDisplay(epd_bitmap_pupilContract);
      } else {
        Serial.println("Dark → expand");
        updateDisplay(epd_bitmap_pupilExpand);
      }
    }
  }

  // browser commands from mouse game v3
  if (Serial.available()) {
    String cmd = Serial.readStringUntil('\n');
    cmd.trim();
    if (cmd == "LIGHT:1" && currentImage != 1 && (millis() - lastRefresh >= MIN_REFRESH_GAP)) {
      Serial.println("Browser LIGHT:1 → contract");
      updateDisplay(epd_bitmap_pupilContract);
      currentImage = 1; lastRefresh = millis();
    }
    else if (cmd == "LIGHT:0" && currentImage != 2 && (millis() - lastRefresh >= MIN_REFRESH_GAP)) {
      Serial.println("Browser LIGHT:0 → expand");
      updateDisplay(epd_bitmap_pupilExpand);
      currentImage = 2; lastRefresh = millis();
    }
    else if (cmd == "RESET") {
      Serial.println("Browser RESET → expand");
      updateDisplay(epd_bitmap_pupilExpand);
      currentImage = 2; lastRefresh = millis();
    }
  }
}